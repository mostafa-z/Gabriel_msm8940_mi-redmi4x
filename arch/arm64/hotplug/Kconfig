## arch/arm64/hotplug/Kconfig
```kconfig
menu "Custom Hotplug drivers"

config CUSTOM_HOTPLUG
	bool "Enable custom hotplug support"

config THUNDERPLUG_CONTROL
	bool "Thunderplug"
	depends on CUSTOM_HOTPLUG
	help
	  This driver hotplugs cpu cores based on per-core load
config ALUCARD_CONTROL
	bool "Alucard"
	depends on CUSTOM_HOTPLUG
	help
	  Known for being battery friendly. Developed by Alucard_24@XDA
endmenu
```
